## conf/layer.conf
```bitbake
# We have a conf and classes directory, add to BBPATH
BBPATH .= ":${LAYERDIR}"

# We have recipes-* directories, add to BBFILES
BBFILES += "${LAYERDIR}/recipes-*/*/*.bb \
            ${LAYERDIR}/recipes-*/*/*.bbappend"

BBFILE_COLLECTIONS += "meta-pokypi"
BBFILE_PATTERN_meta-pokypi = "^${LAYERDIR}/"
BBFILE_PRIORITY_meta-pokypi = "6"

LAYERDEPENDS_meta-pokypi = "core"
LAYERSERIES_COMPAT_meta-pokypi = "thud"
```
